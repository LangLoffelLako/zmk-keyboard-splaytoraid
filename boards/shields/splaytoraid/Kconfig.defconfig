## boards/shields/splaytoraid/Kconfig.defconfig
```kconfig
if SHIELD_SPLAYTORAID

config ZMK_KEYBOARD_NAME
    default "Splaytoraid"

endif
```

## boards/shields/splaytoraid/Kconfig.shield
```kconfig
# No whitespace after the comma or in your keyboard name!
config SHIELD_SPLAYTORAID
    def_bool $(shields_list_contains,splaytoraid)
```
